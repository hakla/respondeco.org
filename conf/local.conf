## conf/local.conf
```bitbake
include "application.conf"

db.default.driver=org.h2.Driver
db.default.url="jdbc:h2:/var/respondeco/respondeco-db/respondeco.db;mode=PostgreSQL;AUTO_SERVER=TRUE" # jdbc:h2:target/h2/ps;AUTO_SERVER=TRUE
db.default.username=sa
db.default.password=""

res.tmp=/var/respondeco/respondeco-images/
res.images=/var/respondeco/respondeco-images/
```
